## main/Kconfig
```kconfig
menu "Lumari"

config LUMARI_RUN_PHASE0
    bool "Run Phase 0 demo (circle, tap=color) instead of Lumari game loop"
    default n
    help
        When set, the app runs the Phase 0 hardware demo (floating circle, tap to change color).
        When unset (default), the full Lumari loop runs (creature, quests, menu, etc.).

config LUMARI_BOARD_QEMU
    bool "Target QEMU emulator (reduced resolution, stubbed peripherals)"
    default n
    help
        Selects the QEMU board profile: 198x240 display, stubbed touch/IMU/RTC.
        Set this for ANY QEMU build (both stub and real-framebuffer modes).

config LUMARI_QEMU
    bool "Use stub framebuffer (prebuilt QEMU without RGB device)"
    default n
    depends on LUMARI_BOARD_QEMU
    help
        When enabled, the QEMU RGB driver uses a heap-backed stub instead of the
        virtual device at 0x21000000. Use this with prebuilt QEMU (idf_tools).
        When disabled (but LUMARI_BOARD_QEMU is set), the real QEMU RGB device
        is used and an SDL window shows the framebuffer.

config LUMARI_RUN_UNIT_TESTS
    bool "Run Unity unit tests at startup (quest_engine, inventory_engine)"
    default n
    help
        When set, app runs unity_run_all_tests() then blocks. Use for CI or
        idf.py qemu. Requires unity component.

endmenu
```

## sdkconfig.defaults
```kconfig
CONFIG_IDF_TARGET="esp32s3"
CONFIG_SPIRAM=y
CONFIG_SPIRAM_USE_CAPS_ALLOC=y
# ESP32-S3R8 (Waveshare 2.06) has 8MB octal PSRAM; quad mode fails with "PSRAM ID read error"
CONFIG_SPIRAM_MODE_OCT=y
CONFIG_ESP_MAIN_TASK_STACK_SIZE=8192
```

## sdkconfig.defaults.qemu
```kconfig
# QEMU emulator board config (virtual display, stubbed touch/IMU/RTC).
# Use with: SDKCONFIG_DEFAULTS="sdkconfig.defaults;sdkconfig.defaults.qemu" idf.py build
# Then run: idf.py qemu --graphics monitor
CONFIG_LUMARI_BOARD_QEMU=y
CONFIG_LUMARI_QEMU=y
# Run full Lumari loop in QEMU (not Phase 0 red-circle demo).
CONFIG_LUMARI_RUN_PHASE0=n
# QEMU has no PSRAM; use internal RAM only.
CONFIG_SPIRAM=n
```

## sdkconfig.defaults.qemu_fb
```kconfig
# QEMU emulator with real framebuffer (use with custom-built QEMU from Espressif fork).
# Use when LUMARI_QEMU_BUILD_DIR is set so the SDL display window works.
# Build: SDKCONFIG_DEFAULTS="sdkconfig.defaults;sdkconfig.defaults.qemu_fb" idf.py build
CONFIG_LUMARI_BOARD_QEMU=y
CONFIG_LUMARI_QEMU=n
# Run full Lumari loop in QEMU (not Phase 0 red-circle demo).
CONFIG_LUMARI_RUN_PHASE0=n
# QEMU has no PSRAM; use internal RAM only.
CONFIG_SPIRAM=n
```
